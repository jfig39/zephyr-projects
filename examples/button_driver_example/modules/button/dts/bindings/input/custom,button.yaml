## examples/button_driver_example/modules/button/dts/bindings/input/custom,button.yaml
```yaml
description: Custom button
compatible: "custom,button"

properties:
  gpios:
    type: phandle-array
    required: true
    description: GPIO connected to the button (flags here)
```
